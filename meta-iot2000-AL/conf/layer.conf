## meta-iot2000-AL/conf/layer.conf
```bitbake
# We have a conf and classes directory, add to BBPATH
BBPATH .= ":${LAYERDIR}"

# We have a recipes-* directories, add to BBFILES
BBFILES += "${LAYERDIR}/recipes-*/*/*.bb \
	${LAYERDIR}/recipes-*/*/*.bbappend"

BBFILE_COLLECTIONS += "iot2000-AL"
BBFILE_PATTERN_iot2000-AL = "^${LAYERDIR}/"
BBFILE_PRIORITY_iot2000-AL = "6"

LAYERDEPENDS_iot2000-AL += " \
	iot2000-bsp \
	intel-iot-mw \
	nodejs \
	"

IOT2000_MIT_LICENSE = "${LAYERDIR}/COPYING.MIT"
IOT2000_GPLv2_LICENSE = "${LAYERDIR}/COPYING.GPLv2"
```
